#include "LvInput.h"
#include "Theme.h"
#include "hal/Keyboard.h"
#include "hal/Trackball.h"
#include "hal/TouchInput.h"

namespace LvInput {

#if 0 // Dead code: bitmap cursor icon — replaced by LVGL shape cursor in init()
const uint8_t mouse_cursor_icon_map[] = {
#if LV_COLOR_DEPTH == 1 || LV_COLOR_DEPTH == 8
    /*Pixel format: Alpha 8 bit, Red: 3 bit, Green: 3 bit, Blue: 2 bit*/
    0x24, 0xb8, 0x24, 0xc8, 0x00, 0x13, 0x00, 0x00, 0x00, 0x03, 0x00, 0x00, 0x00, 0x00, 0x00, 0x00, 0x00, 0x00, 0x00, 0x00, 0x00, 0x00, 0x00, 0x00, 0x00, 0x00, 0x00, 0x00,
    0x49, 0xcc, 0xdb, 0xff, 0x49, 0xcc, 0x00, 0x24, 0x00, 0x00, 0x00, 0x00, 0x00, 0x00, 0x00, 0x00, 0x00, 0x00, 0x00, 0x00, 0x00, 0x00, 0x00, 0x00, 0x00, 0x00, 0x00, 0x00,
    0x49, 0xc8, 0xff, 0xff, 0xff, 0xff, 0x49, 0xe0, 0x00, 0x3b, 0x00, 0x00, 0x00, 0x00, 0x00, 0x00, 0x00, 0x00, 0x00, 0x00, 0x00, 0x00, 0x00, 0x00, 0x00, 0x00, 0x00, 0x00,
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    0x00, 0x03, 0x00, 0x03, 0x00, 0x00, 0x00, 0x00, 0x00, 0x00, 0x00, 0x00, 0x00, 0x1f, 0x25, 0xd7, 0x49, 0xc7, 0x00, 0x47, 0x00, 0x08, 0x00, 0x00, 0x00, 0x00, 0x00, 0x00,
#endif
#if LV_COLOR_DEPTH == 16 && LV_COLOR_16_SWAP == 0
    /*Pixel format: Alpha 8 bit, Red: 5 bit, Green: 6 bit, Blue: 5 bit*/
    0xc3, 0x18, 0xb8, 0xe4, 0x20, 0xc8, 0x00, 0x00, 0x13, 0x00, 0x00, 0x00,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 0x00,
    0x49, 0x4a, 0xcc, 0x96, 0xb5, 0xff, 0xc7, 0x39, 0xcc, 0x00, 0x00, 0x24,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 0x00,
    0xe7, 0x39, 0xc8, 0xbf, 0xff, 0xff, 0xfb, 0xde, 0xff, 0x28, 0x42, 0xe0,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 0x00,
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    0x41, 0x08, 0x03, 0x00, 0x00, 0x03, 0x00, 0x00, 0x00, 0x00, 0x00, 0x00,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 0x00,
#endif
#if LV_COLOR_DEPTH == 16 && LV_COLOR_16_SWAP != 0
    /*Pixel format: Alpha 8 bit, Red: 5 bit, Green: 6 bit, Blue: 5 bit  BUT the 2  color bytes are swapped*/
    0x18, 0xc3, 0xb8, 0x20, 0xe4, 0xc8, 0x00, 0x00, 0x13, 0x00, 0x00, 0x00,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 0x00,
    0x4a, 0x49, 0xcc, 0xb5, 0x96, 0xff, 0x39, 0xc7, 0xcc, 0x00, 0x00, 0x24,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 0x00,
    0x39, 0xe7, 0xc8, 0xff, 0xbf, 0xff, 0xde, 0xfb, 0xff, 0x42, 0x28, 0xe0,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 0x00,
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    0x08, 0x41, 0x03, 0x00, 0x00, 0x03, 0x00, 0x00, 0x00, 0x00, 0x00, 0x00,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 0x00,
#endif
#if LV_COLOR_DEPTH == 32
    0x19, 0x19, 0x19, 0xb8, 0x1e, 0x1e, 0x1e, 0xc8, 0x00, 0x00, 0x00, 0x13,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 0x00,
    0x48, 0x48, 0x48, 0xcc, 0xb2, 0xb2, 0xb2, 0xff, 0x3a, 0x3a, 0x3a, 0xcc,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 0x00,
    0x3b, 0x3b, 0x3b, 0xc8, 0xf6, 0xf6, 0xf6, 0xff, 0xdc, 0xdc, 0xdc, 0xff,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 0x00,
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    0x09, 0x09, 0x09, 0x03, 0x02, 0x02, 0x02, 0x03, 0x00, 0x00, 0x00, 0x00,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 0x00,
#endif
};

static lv_img_dsc_t mouse_cursor_icon = {
    .header = {
        .cf = LV_IMG_CF_TRUE_COLOR_ALPHA,
        .always_zero = 0,
        .w = 14,
        .h = 20,
    },
    .data_size = 280 * LV_IMG_PX_SIZE_ALPHA_BYTE,
    .data = mouse_cursor_icon_map,
};
#endif // Dead cursor icon

static Keyboard* s_kb = nullptr;
static Trackball* s_tb = nullptr;
static TouchInput* s_touch = nullptr;
static lv_group_t* s_group = nullptr;
static lv_obj_t* s_cursor = nullptr;

// Keypad indev state
static uint32_t s_lastKey = 0;
static lv_indev_state_t s_keyState = LV_INDEV_STATE_RELEASED;
static bool s_keyReady = false;

// Touch cursor auto-hide after 1s of no touch
static unsigned long s_lastTouchMs = 0;
static bool s_cursorVisible = false;

// Suppress touch for 300ms after trackball/keyboard use to prevent accidental taps
static unsigned long s_lastKeyMs = 0;
static constexpr unsigned long TOUCH_SUPPRESS_MS = 300;

static void touchpad_read_cb(lv_indev_drv_t *indev_driver, lv_indev_data_t *data) {
    // Ignore touch input briefly after trackball/keyboard use
    if (millis() - s_lastKeyMs < TOUCH_SUPPRESS_MS) {
        data->state = LV_INDEV_STATE_REL;
        return;
    }

    if (s_touch->isTouched()) {
        lv_obj_clear_flag(s_cursor, LV_OBJ_FLAG_HIDDEN);
        s_cursorVisible = true;
        s_lastTouchMs = millis();
        data->state = LV_INDEV_STATE_PR;
        data->point.x = s_touch->x();
        data->point.y = s_touch->y();
    } else {
        data->state = LV_INDEV_STATE_REL;
        if (s_cursorVisible && millis() - s_lastTouchMs > 1000) {
            lv_obj_add_flag(s_cursor, LV_OBJ_FLAG_HIDDEN);
            s_cursorVisible = false;
        }
    }
}

static void keypad_read_cb(lv_indev_drv_t* drv, lv_indev_data_t* data) {
    if (s_keyReady) {
        s_lastKeyMs = millis();
        lv_obj_add_flag(s_cursor, LV_OBJ_FLAG_HIDDEN);
        data->key = s_lastKey;
        data->state = s_keyState;
        s_keyReady = false;
    } else {
        data->state = LV_INDEV_STATE_RELEASED;
    }
}

void init(Keyboard* kb, Trackball* tb, TouchInput* touch) {
    s_kb = kb;
    s_tb = tb;
    s_touch = touch;

    // Create input group
    s_group = lv_group_create();
    lv_group_set_default(s_group);

    // Register keypad indev
    static lv_indev_drv_t keyDrv;
    lv_indev_drv_init(&keyDrv);
    keyDrv.type = LV_INDEV_TYPE_KEYPAD;
    keyDrv.read_cb = keypad_read_cb;
    lv_indev_t* keyIndev = lv_indev_drv_register(&keyDrv);
    lv_indev_set_group(keyIndev, s_group);

    // Register a touchscreen input device
    static lv_indev_drv_t touchDrv;
    lv_indev_drv_init(&touchDrv);
    touchDrv.type = LV_INDEV_TYPE_POINTER;
    touchDrv.read_cb = touchpad_read_cb;
    lv_indev_t* touchIndev = lv_indev_drv_register(&touchDrv);
    lv_indev_set_group(touchIndev, s_group);

    // Touch cursor: semi-transparent center with brand orange ring
    s_cursor = lv_obj_create(lv_layer_sys());
    lv_obj_set_size(s_cursor, 14, 14);
    lv_obj_set_style_radius(s_cursor, 7, 0);
    lv_obj_set_style_bg_color(s_cursor, lv_color_hex(Theme::BG), 0);
    lv_obj_set_style_bg_opa(s_cursor, LV_OPA_60, 0);
    lv_obj_set_style_outline_color(s_cursor, lv_color_hex(Theme::PRIMARY), 0);
    lv_obj_set_style_outline_width(s_cursor, 1, 0);
    lv_obj_set_style_outline_opa(s_cursor, LV_OPA_COVER, 0);
    lv_obj_set_style_border_width(s_cursor, 0, 0);
    lv_obj_clear_flag(s_cursor, LV_OBJ_FLAG_SCROLLABLE | LV_OBJ_FLAG_CLICKABLE);
    // Center the cursor on the touch point (LVGL positions top-left by default)
    lv_obj_set_style_translate_x(s_cursor, -7, 0);
    lv_obj_set_style_translate_y(s_cursor, -7, 0);
    lv_indev_set_cursor(touchIndev, s_cursor);
    lv_obj_add_flag(s_cursor, LV_OBJ_FLAG_HIDDEN);

    Serial.println("[LVGL] Input drivers registered (touch enabled)");
}

void feedKey(const KeyEvent& evt) {
    uint32_t key = 0;

    if (evt.enter) key = LV_KEY_ENTER;
    else if (evt.up) key = LV_KEY_PREV;
    else if (evt.down) key = LV_KEY_NEXT;
    else if (evt.left) key = LV_KEY_LEFT;
    else if (evt.right) key = LV_KEY_RIGHT;
    else if (evt.del) key = LV_KEY_BACKSPACE;
    else if (evt.tab) key = LV_KEY_NEXT;
    else if (evt.character == 0x1B) key = LV_KEY_ESC;
    else return;  // Don't feed printable chars — screens handle them via handleKey()

    s_lastKey = key;
    s_keyState = LV_INDEV_STATE_PRESSED;
    s_keyReady = true;
}

lv_group_t* group() {
    return s_group;
}

}  // namespace LvInput
